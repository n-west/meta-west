## conf/layer.conf
```bitbake
# We have a conf directory, append it to BBPATH
BBPATH .= ":${LAYERDIR}"

# We have a recipes directory, add to BBFILES
BBFILES += "${LAYERDIR}/recipes*/*/*.bb ${LAYERDIR}/recipes*/*/*.bbappend"

BBFILE_COLLECTIONS += "west"
BBFILE_PRIORITY_west = "1"
BBFILE_PATTERN_west = "${LAYERDIR}"
```
